## bsoe-recipes/meta-bs/conf/layer.conf
```bitbake
# Layer configuration for BrightSign meta-bs
BBPATH .= ":${LAYERDIR}"

BBFILES += "${LAYERDIR}/recipes-*/*/*.bb \
            ${LAYERDIR}/recipes-*/*/*.bbappend"

BBFILE_COLLECTIONS += "meta-bs bs-layer"
BBFILE_PATTERN_meta-bs = "^${LAYERDIR}/"
BBFILE_PATTERN_bs-layer = "^${LAYERDIR}/"
BBFILE_PRIORITY_meta-bs = "6"
BBFILE_PRIORITY_bs-layer = "6"

LAYERDEPENDS_meta-bs = "core"
LAYERSERIES_COMPAT_meta-bs = "dunfell gatesgarth hardknott honister kirkstone langdale mickledore nanbield scarthgap"
LAYERSERIES_COMPAT_bs-layer = "dunfell gatesgarth hardknott honister kirkstone langdale mickledore nanbield scarthgap"
```
